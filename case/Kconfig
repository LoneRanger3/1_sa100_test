## case/Kconfig
```kconfig
menu "RT-Thread Case"

config RT_SEL_CAR_VIDEO_CASE
    bool "Select car video cases"
    default n

endmenu
```

## eos/Kconfig
```kconfig
source "$RTT_DIR/src/Kconfig"
source "$RTT_DIR/libcpu/Kconfig"
source "$RTT_DIR/components/Kconfig"
source "$RTT_DIR/../framework/Kconfig"
source "$RTT_DIR/../media/Kconfig"
source "$RTT_DIR/../case/Kconfig"
```

## eos/bsp/lombo/Kconfig
```kconfig
mainmenu "RT-Thread Project Configuration"

config $BSP_DIR
    string
    option env="BSP_ROOT"
    default "."

config $RTT_DIR
    string
    option env="RTT_ROOT"
    default "../.."

source "$RTT_DIR/Kconfig"

config ENABLE_MMU
    bool "enable mmu on boot"
    default y

config ENABLE_DCACHE
    bool "enable data cache on boot"
    select RT_USING_CACHE
    default y

config RT_USING_CACHE
    bool
    default y if ENABLE_DCACHE
    default n

config ENABLE_ICACHE
    bool "enable instruction cache on boot"
    default y

config RT_USING_VFP
    bool "enable VFP"
    default y

config USING_NEON_LIBC
    bool "enable use neon libc function"
    default y

config ARCH_LOMBO
    bool "lombo platform support"

#---------------------------start of board selection---------------------------

#
# 1. CPU arch select
#
if ARCH_LOMBO
choice
    prompt "lombo CPU arch select"
    default ARCH_LOMBO_N7

    config ARCH_LOMBO_N7
        bool "E81 CPU architecture"
        select ARCH_ARM_CORTEX_A7
endchoice
endif  # ARCH_LOMBO

#
# 2. Soc select
#
if ARCH_LOMBO_N7
choice
    prompt "Soc select"
    default ARCH_LOMBO_N7V1

    config ARCH_LOMBO_N7V1
        bool "The Second Soc with E81 CPU"
endchoice
endif  # ARCH_LOMBO_N7

#
# 3. board select
#
if ARCH_LOMBO_N7V1
choice
    prompt "Board select"
    default ARCH_LOMBO_N7V1_CDR

    config ARCH_LOMBO_N7V1_CDR
        bool "CDR board for N7V1 Soc"
endchoice
endif  # ARCH_LOMBO_N7V1

#---------------------------end of board selection-----------------------------

config LOMBO_DRAM_PBASE
    hex "The dram start physic address"
    default 0x40000000
    help
        It should be configured once, according to the spec.
        If you are not sure, keep the default value.

#config LOMBO_DRAM_SIZE
#    hex "The dram size for the platform"
#    default 0x10000000
#    help
#        The dram size is different for each platform, and it
#        should be configured to the actual size.

if ENABLE_MMU
config LOMBO_DRAM_VBASE
    hex "The dram start virtual address"
    default 0xC0000000
    help
        This value is normally 0xC0000000, it is passed to the linker
        script when mmu is enabled.
endif

source "$BSP_DIR/drivers/Kconfig"
```

## eos/bsp/lombo/drivers/Kconfig
```kconfig
menuconfig LOMBO_TEST
    bool "lombo test module"
    depends on ARCH_LOMBO
    default n

if LOMBO_TEST

config LOMBO_TEST_MEMORY
    bool "test memory management functions"
    default n
    help
        Test memory management functions, such as rt_malloc, rt_mp_alloc, etc.

config LOMBO_TEST_CACHE
    bool "test cache operations"
    default n

config LOMBO_TEST_DMA
    bool "test dma operations"
    default n
    help
        Test sg and cyclic mem to mem transfer.

config LOMBO_TEST_CLK
    bool "test clock functions"
    depends on LOMBO_TEST
    default n
    help
        Test clk functions, such as clk_get, clk_get_rate, clk_get_parent etc.

config LOMBO_TEST_GPIO
    bool "test gpio functions"
    depends on LOMBO_TEST
    default n
    help
        Test pinctrl module.

config LOMBO_TEST_UART
    bool "test UART functions"
    depends on LOMBO_TEST
    default n
    help
        Test uart module.

config LOMBO_TEST_PWM
    bool "test PWM functions"
    depends on (LOMBO_TEST && RT_USING_PWM)
    default n
    help
        Test pwm module.

config LOMBO_TEST_MEMCTRL
    bool "test memctrl functions"
    depends on (LOMBO_TEST && RT_USING_MEMCTRL)
    default n
    help
        Test memctrl module.

config LOMBO_TEST_SDC
    bool "test sdc driver functions"
    depends on (LOMBO_TEST && LOMBO_SDC)
    default n

config LOMBO_TEST_SPI_NOR
    bool "test spi nor driver functions"
    depends on (LOMBO_TEST && (LOMBO_SPI_NOR || RT_USING_SFUD))
    default n

config LOMBO_TEST_CFG
    bool "test system config driver functions"
    depends on (LOMBO_TEST)
    default n

config LOMBO_TEST_PM
    bool "test power management functions"
    depends on (LOMBO_TEST && RT_USING_PM)
    default n

config LOMBO_TEST_KEYBOARD
    bool "keyboard driver test cases"
    depends on (LOMBO_TEST && LOMBO_KEYBOARD)
    default y

config LOMBO_TEST_TOUCH_SCREEN
    bool "touch screen driver test cases"
    depends on (LOMBO_TEST && LOMBO_TOUCH_SCREEN)
    default y

config LOMBO_TEST_INPUT
    bool "input subsystem driver test cases"
    depends on (LOMBO_TEST)
    default y

config LOMBO_TEST_GSENSOR
    bool "gsensor driver test cases"
    depends on (LOMBO_TEST && LOMBO_GSENSOR)
    default y

config LOMBO_TEST_GPS
    bool "gps driver test cases"
    depends on (LOMBO_TEST && LOMBO_GPS)
    default y

config LOMBO_TEST_RTC
    bool "test rtc driver functions"
    depends on (LOMBO_TEST && RT_USING_RTC)
    default n

config LOMBO_TEST_VISS
    bool "test viss driver functions"
    depends on (LOMBO_TEST && RT_USING_VISS)
    default n

config LOMBO_TEST_SYS
    bool "test eos base operations, such as sem, event, posix.."
    depends on LOMBO_TEST
    default n

config LOMBO_TEST_PTHREAD
    bool "test pthread functions"
    depends on LOMBO_TEST
    default n

config LOMBO_TEST_PTHREAD_MUTEX
    bool "test pthread_mutex_ functions"
    depends on LOMBO_TEST
    default n

config LOMBO_TEST_SPINLOCK
    bool "test spinlock functions"
    depends on LOMBO_TEST
    default n

config LOMBO_TEST_VFP
    bool "test eos vfp operations"
    depends on (LOMBO_TEST && RT_USING_VFP)
    default n

config LOMBO_TEST_NEON
    bool "test eos neon operations"
    depends on (LOMBO_TEST && RT_USING_VFP)
    default n

config LOMBO_TEST_AUDIO
    bool "audio driver test cases"
    depends on (LOMBO_TEST && LOMBO_AUDIO)
    default n

config LOMBO_TEST_ISP
    bool "test isp driver functions"
	depends on (LOMBO_TEST && RT_USING_ISP)
	default n

config LOMBO_TEST_CPU
    bool "test cpu hotpulg"
    depends on (LOMBO_TEST && HOTPLUG_CPU)
    default n

if RT_USING_WDT
    config LOMBO_TEST_WDOG
        bool
        prompt "test watchdog functions"
        default n
endif

config LOMBO_TEST_BINDTIMER
    bool "test cpu-binded timer function"
    depends on (LOMBO_TEST && RT_USING_BIND_TIMER)
    default n

config LOMBO_TEST_DEADLOCK_MONITOR
    bool "test deadlock monitor feature"
    depends on (LOMBO_TEST && RT_USING_DEADLOCK_MONITOR)
    default n

config LOMBO_TEST_I2C
    bool "i2c driver test cases"
    depends on (LOMBO_TEST && LOMBO_I2C && LOMBO_I2C_BY24C)
    default n

config LOMBO_TEST_DISP
    bool "test disp driver functions"
	depends on (LOMBO_TEST && LOMBO_DISP)
	default n

config LOMBO_TEST_OSAL_MEM
    bool "test osal_mem functions"
	depends on (LOMBO_TEST)
	default y

config LOMBO_TEST_CPUFREQ
    bool "test cpufreq"
    depends on (LOMBO_TEST && LOMBO_CPUFREQ)
    default n

endif # LOMBO_TEST

config DEBUG_LIST
    bool "debug list module"
    default y

config LOMBO_DMA
	bool "lombo DMA module"
	depends on (ARCH_LOMBO && ARCH_LOMBO_N7)
	default n

config LOMBO_AUDIO
	bool "lombo audio module"
	depends on (ARCH_LOMBO)
	default n

config LOMBO_GPADC
	bool "lombo GPADC module"
	depends on (ARCH_LOMBO)
	default y

config LOMBO_POWER
	bool "lombo power module"
	depends on (ARCH_LOMBO && LOMBO_GPADC)
	default y

config LOMBO_ACC_SIO5
	bool "lombo acc sio5 module"
	default n

config LOMBO_KEYBOARD
	bool "lombo keyboard module"
	depends on (ARCH_LOMBO && LOMBO_GPADC)
	default n

config LOMBO_TOUCH_SCREEN
	bool "lombo touch screen module"
	depends on (ARCH_LOMBO)
	default n

config LOMBO_TOUCH_SCREEN_GT913
	bool "lombo touch screen GOODIX module"
	depends on (ARCH_LOMBO && LOMBO_TOUCH_SCREEN)
	default n

config LOMBO_TOUCH_SCREEN_GSLX680
	bool "lombo touch screen silead module"
	depends on (ARCH_LOMBO && LOMBO_TOUCH_SCREEN)
	default n

config LOMBO_TOUCH_SCREEN_FOCALTECH
	bool "lombo touch screen focaltech module"
	depends on (ARCH_LOMBO && LOMBO_TOUCH_SCREEN)
	default n

config LOMBO_TOUCH_SCREEN_EGALAX_EXC3111
	bool "lombo touch screen egalax module"
	depends on (ARCH_LOMBO && LOMBO_TOUCH_SCREEN)
	default n

config LOMBO_GSENSOR
	bool "lombo gsensor module"
	depends on (ARCH_LOMBO)
	default n

config LOMBO_IR
	bool "lombo ir module"
	depends on (ARCH_LOMBO)
	default n

menuconfig LOMBO_GPS
    bool "lombo GPS module"
    depends on (ARCH_LOMBO)
    default n

    if LOMBO_GPS
        config LOMBO_GPS_Q8
            bool "using Q8 GPS module"
            default n

        config LOMBO_GPS_ST658G
            bool "using ST658G-G11 GPS module"
            default n

    endif

config RT_USING_ALARM
	bool "using RTC alarm"
	depends on (ARCH_LOMBO && RT_USING_RTC)
	default y

config RT_USING_DUMP
	bool "lombo dump reg driver"
	depends on (ARCH_LOMBO)
	default n

config LOMBO_CPUFREQ
	bool "lombo cpufreq module"
	default n

if LOMBO_CPUFREQ
	source "$BSP_DIR/drivers/cpufreq/Kconfig"
endif

config LOMBO_THERMAL
	bool "lombo thermal module"
	default n

if LOMBO_THERMAL
	source "$BSP_DIR/drivers/thermal/Kconfig"
endif

config LOMBO_SAVE_LOG
	bool "lombo save log to sdcard"
	depends on (ARCH_LOMBO)
	default n

menuconfig LOMBO_DISP
	bool "lombo DISP module"
	depends on ARCH_LOMBO
	default y

if LOMBO_DISP
	source "$BSP_DIR/drivers/disp/Kconfig"
endif

menuconfig LOMBO_GPIO
	bool "lombo gpio(pinctrl) module"
	depends on ARCH_LOMBO
	default y

source "$BSP_DIR/drivers/usb/Kconfig"

menuconfig LOMBO_WIFI_MODULE
	bool "lombo wifi module"
	depends on (ARCH_LOMBO && RT_USING_WIFI && RT_USING_LWIP)
	default y

if LOMBO_WIFI_MODULE
	source "$BSP_DIR/drivers/net/Kconfig"
endif
```

## eos/bsp/lombo/drivers/cpufreq/Kconfig
```kconfig
config LOMBO_CPU_ADPLL
	bool "LOMBO CPU use ADPLL"
	depends on LOMBO_CPUFREQ
	default y
	help
	This support cpu use ADPLL instead of PRCM.

	If in doubt, say N.

config CPUFREQ_GOVERNOR_ADAPTIVE
	bool "Cpufreq Adaptive Governor"
	depends on LOMBO_CPUFREQ
	default y
	help
	This support cpu use adaptive governor.

	If in doubt, say N.
```

## eos/bsp/lombo/drivers/disp/Kconfig
```kconfig
config DEFAULT_SCREEN_WIDTH
		int "Screen width size"
		depends on LOMBO_DISP
		default 800

config DEFAULT_SCREEN_HEIGHT
		int "Screen heigh size"
		depends on LOMBO_DISP
		default 480

config LOMBO_DISP_HWC
	bool "Enable HWC"
	depends on LOMBO_DISP
	default y

source "$BSP_DIR/drivers/disp/panel/Kconfig"
```

## eos/bsp/lombo/drivers/disp/panel/Kconfig
```kconfig
config LOMBO_DISP_PANEL
	bool "lombo disp panel config"
	depends on LOMBO_DISP
	default y

	if LOMBO_DISP_PANEL
	choice
		prompt "Panel selection"
		default	PANEL_WT1096601G01_24_IVO

		config PANEL_SPC_S92048
			bool "spc-s92048"

		config PANEL_TIANMA_TM070JDHG30
			bool "tianma-tm070jdhg30"

		config PANEL_SLM5P5_HX8399C
			bool "slm5p5-hx8399c"

		config PANEL_WT1096601G01_24_IVO
			bool "wtl096601G01-24-ivo"

		config PANEL_ZT0936BOE
			bool "ZT0936BOE"

		config PANEL_WT1116601G01_24
			bool "wtl116601G01-24"

		config PANEL_WT1096602G02_24
			bool "wtl096602G02-24"

		config PANEL_ZT1180_2401
			bool "zt1180-2401"

		config PANEL_FCX701B21B2
			bool "fcx701b21b2"

		config PANEL_EK79003A_WKS70002
			bool "ek79003a-wks70002"

		config PANEL_YC024B_10HV
			bool "yc024b-10hv"
	endchoice
	endif
```

## eos/bsp/lombo/drivers/i2c/Kconfig
```kconfig
config LOMBO_I2C_BY24C
	bool "Enable by24c EEPROM driver"
	depends on LOMBO_I2C
	default y

if LOMBO_I2C_BY24C
	config RT_I2C_BY24C_HOST
		int "Set by24c i2c host"
		default 0
endif
```

## eos/bsp/lombo/drivers/net/Kconfig
```kconfig
config RTL8189FTV_MODULE
	bool "use realtek rtl8189ftv"
	depends on (LOMBO_WIFI_MODULE && LOMBO_SDC)
	default n
```

## eos/bsp/lombo/drivers/thermal/Kconfig
```kconfig
config LOMBO_CPUFREQ_COOLING
	bool "lombo cpufreq cooling module"
	depends on LOMBO_CPUFREQ
	depends on LOMBO_THERMAL
	default n
```

## eos/bsp/lombo/drivers/usb/Kconfig
```kconfig
config LOMBO_USB_HOST
	bool "Lombo host controller"
	depends on (RT_USING_USB_HOST)

config LOMBO_USB_UDC
	bool "Lombo device controller"
	depends on (RT_USING_USB_DEVICE)
```

## eos/bsp/lombo/drivers/viss/Kconfig
```kconfig
config RT_USING_VIC
    bool "VIC controller support"
    default y

config RT_USING_VIC_DET_SIGNAL
	bool "lombo vic detection module"
	default y

config RT_USING_VIC_DET
	  bool "VIC Detection module support"
	  default n

config RT_USING_MCSI
    bool "MIPI CSI controller support"
    default y

config RT_USING_ISP
    bool "ISP controller support"
    default n

menu "Sensors select"
	config RT_USING_OV5640_DVP
		bool "OV5640 DVP support"
		default n
		select LOMBO_I2C
	config RT_USING_OV5640_MIPI
		bool "OV5640 MIPI support"
		default n
		select LOMBO_I2C
	config RT_USING_SC1335T_MIPI
		bool "SC1335T MIPI support"
		default n
		select LOMBO_I2C
	config RT_USING_OV2710_DVP
		bool "OV2710 DVP support"
		default n
		select LOMBO_I2C
	config RT_USING_SC2363_MIPI
		bool "SC2363 MIPI support"
		default n
		select LOMBO_I2C
	config RT_USING_SC4353_MIPI
		bool "SC4353 MIPI support"
		default n
		select LOMBO_I2C
	config RT_USING_RN6752_DVP
		bool "RN6752 DVP support"
		default n
		select LOMBO_I2C
	config RT_USING_RN6752M_DVP
		bool "RN6752M DVP support"
		default n
		select LOMBO_I2C
	config RT_USING_SC2363P_MIPI
		bool "SC2363P MIPI support"
		default n
		select LOMBO_I2C
	config RT_USING_GC2053_MIPI
		bool "GC2053 MIPI support"
		default n
		select LOMBO_I2C
	config RT_USING_IMX307_MIPI
		bool "IMX307 MIPI support"
		default n
		select LOMBO_I2C
	config RT_USING_TP9930_DVP
		bool "TP9930 DVP support"
		default n
		select LOMBO_I2C
	config RT_USING_TP9950_DVP
		bool "TP9950 DVP support"
		default n
		select LOMBO_I2C
	config RT_USING_BG0806_MIPI
		bool "BG0806 MIPI support"
		default n
		select LOMBO_I2C
endmenu
```

## framework/Kconfig
```kconfig
menu "RT-Thread Gui"

config RT_USING_EGUI
    bool "Graphic drawing engine"
    select LOMBO_DISP
    default n
	
if RT_USING_EGUI
choice
    prompt "Gui select"
    config RT_USING_LITTLEVGL
        bool "Littlevgl"
        select RT_USING_PTHREADS
        default y
endchoice
endif

config RT_USING_LOMBO_JSON_UI
    bool "LOMBO JSON UI Frame"
    select LOMBO_JSON_UI
    default n

config RT_USING_LOMBO_SERIAL_MOUSE
    bool "LOMBO SERIAL MOUSE"
    select RT_USING_EGUI
    default n
	
endmenu
```

## media/Kconfig
```kconfig
menu "RT-Thread Media"

config RT_USING_LBMEDIA
	bool "lombo mutimedia"
	select LOMBO_DISP
	default n

config LOMBO_TEST_MEDIA
	bool "test lombo mutimedia"
	depends on RT_USING_LBMEDIA
	default y

endmenu
```
